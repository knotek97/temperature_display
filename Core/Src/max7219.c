#include "max7219.h"

// Zugriff auf den SPI-Handle aus der main.c
extern SPI_HandleTypeDef hspi3;

// Globale Variablen für die Laufschrift
uint8_t scroll_buffer[SCROLL_BUFFER_SIZE];
uint16_t scroll_length = 0;

// Kompletter 8x8 ASCII Font (Zeichen 32 ' ' bis 126 '~')
// Jede Zeile repräsentiert ein Zeichen. Die Bytes sind die Spalten des Zeichens.
const uint8_t font_8x8[95][8] = {
    {0x00,0x00,0x00,0x00,0x00,0x00,0x00,0x00}, // 32: Space
    {0x00,0x00,0x5F,0x00,0x00,0x00,0x00,0x00}, // 33: !
    {0x00,0x07,0x00,0x07,0x00,0x00,0x00,0x00}, // 34: "
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    {0x08,0x04,0x08,0x10,0x08,0x00,0x00,0x00}  // 126: ~
};

// Interne Hilfsfunktion zum Drehen um 90 Grad im Uhrzeigersinn
static void Rotate90(uint8_t* in, uint8_t* out) {
    for (int i = 0; i < 8; i++) {
        out[i] = 0;
        for (int j = 0; j < 8; j++) {
            if (in[7 - j] & (1 << i)) {
                out[i] |= (1 << j);
            }
        }
    }
}

void MAX7219_Write(uint8_t reg, uint8_t data) {
    uint8_t tx_buffer[2];
    tx_buffer[0] = reg;
    tx_buffer[1] = data;
    HAL_GPIO_WritePin(MATRIX_CS_GPIO_Port, MATRIX_CS_Pin, GPIO_PIN_RESET);
    HAL_SPI_Transmit(&hspi3, tx_buffer, 2, 10);
    HAL_GPIO_WritePin(MATRIX_CS_GPIO_Port, MATRIX_CS_Pin, GPIO_PIN_SET);
}

void MAX7219_Init(void) {
    MAX7219_Write(MAX7219_REG_DISPLAY_TEST, 0x00);
    MAX7219_Write(MAX7219_REG_DECODE_MODE, 0x00);
    MAX7219_Write(MAX7219_REG_INTENSITY, 0x07);
    MAX7219_Write(MAX7219_REG_SCAN_LIMIT, 0x07);
    MAX7219_Write(MAX7219_REG_SHUTDOWN, 0x01);
    for(uint8_t i = 1; i <= 8; i++) {
        MAX7219_Write(i, 0x00);
    }
}

// Wandelt einen String (z.B. "24 C") in Spalten für den scroll_buffer um
void MAX7219_LoadString(char* text) {
    int col = 0;

    // Zuerst 8 leere Spalten, damit der Text sanft von rechts hereinscrollt
    for(int i = 0; i < 8; i++) {
        if(col < SCROLL_BUFFER_SIZE) scroll_buffer[col++] = 0;
    }

    // Jeden Buchstaben des Strings verarbeiten
    while(*text) {
        char c = *text;

        // Prüfen ob Zeichen im druckbaren ASCII Bereich liegt
        if(c < 32 || c > 126) c = 32; // Unbekannte Zeichen durch Leerzeichen ersetzen

        int font_idx = c - 32; // Offset berechnen (Leertaste ist Index 0)

        // Die 8 Spalten des Zeichens in den Buffer kopieren
        for(int i = 0; i < 8; i++) {
            if (col < SCROLL_BUFFER_SIZE) {
                scroll_buffer[col++] = font_8x8[font_idx][i];
            }
        }
        text++; // Nächster Buchstabe
    }

    // Am Ende nochmal 8 leere Spalten, damit der Text komplett nach links herausfährt
    for(int i = 0; i < 8; i++) {
        if(col < SCROLL_BUFFER_SIZE) scroll_buffer[col++] = 0;
    }

    // Die berechnete Gesamtlänge speichern
    scroll_length = col;
}

// Die bekannte Funktion zum Anzeigen ohne Drehung
void MAX7219_ShowWindow(uint8_t offset, uint8_t rotation) {
    uint8_t rows[8] = {0};

    // 1. Fenster wie gewohnt (ungedreht) aus dem Puffer berechnen
    for(int c = 0; c < 8; c++) {
        uint8_t column_data = 0;

        if((offset + c) < scroll_length) {
            column_data = scroll_buffer[offset + c];
        }

        for(int r = 0; r < 8; r++) {
            if(column_data & (1 << r)) {
                rows[r] |= (1 << (7 - c));
            }
        }
    }

    // 2. DREHUNG ANWENDEN (Neu!)
    uint8_t final_rows[8];

    // Standardmäßig das ungedrehte Bild übernehmen (0 Grad)
    for(int i = 0; i < 8; i++) final_rows[i] = rows[i];

    // Je nach "rotation" (1=90°, 2=180°, 3=270°) die Matrix mehrfach drehen
    for(int rot = 0; rot < rotation; rot++) {
        uint8_t temp[8];
        Rotate90(final_rows, temp);

        // Ergebnis wieder in final_rows speichern für den nächsten Durchlauf
        for(int i = 0; i < 8; i++) final_rows[i] = temp[i];
    }

    // 3. Das fertige Bild an die Matrix senden
    for(int r = 0; r < 8; r++) {
        MAX7219_Write(r + 1, final_rows[r]);
    }
}
